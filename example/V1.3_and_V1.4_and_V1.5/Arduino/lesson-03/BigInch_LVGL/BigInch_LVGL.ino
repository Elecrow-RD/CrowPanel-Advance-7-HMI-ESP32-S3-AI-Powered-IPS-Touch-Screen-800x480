#include <Arduino.h>
#include <Wire.h>
#include <SPI.h>

#include "pins_config.h"
#include "LovyanGFX_Driver.h"
#include <lvgl.h>
#include <stdbool.h>

#include "ui.h"

LGFX gfx;

static constexpr uint32_t LVGL_BUFFER_LINES = 40;

/* Change to your screen resolution */
static uint8_t *buf;
static uint8_t *buf1;

uint16_t touch_x, touch_y;

/**
 * @brief Transfer an LVGL drawing area to the LCD.
 * @param disp LVGL display requesting the refresh.
 * @param area Inclusive rectangle that must be updated.
 * @param px_map RGB565 pixel data generated by LVGL.
 * Called by LVGL whenever a rendered area is ready for the panel.
 */
void my_disp_flush(lv_display_t *disp, const lv_area_t *area, uint8_t *px_map) {
  if (gfx.getStartCount() > 0) {
    gfx.endWrite();
  }
  gfx.pushImage(area->x1, area->y1, area->x2 - area->x1 + 1, area->y2 - area->y1 + 1, (lgfx::rgb565_t *)px_map);

  lv_display_flush_ready(disp);  //	Tell lvgl that the refresh is complete
}

/**
 * @brief Report the current touch state to LVGL.
 * @param indev LVGL input device requesting a sample.
 * @param data Output structure receiving state and coordinates.
 * Called by LVGL while processing input events.
 */
void my_touchpad_read(lv_indev_t *indev, lv_indev_data_t *data)
{
  data->state = LV_INDEV_STATE_REL;// The state of data existence when releasing the finger
  bool touched = gfx.getTouch( &touch_x, &touch_y );
  if (touched)
  {
    data->state = LV_INDEV_STATE_PR;

    //  Set coordinates
    data->point.x = touch_x;
    data->point.y = touch_y;
    Serial.printf("Screen Touched! X: %d, Y: %d\n", data->point.x, data->point.y);
  }
}

/** @brief Probe an I2C address. @return true when acknowledged. */
bool i2cScanForAddress(uint8_t address) {
  Wire.beginTransmission(address);
  return (Wire.endTransmission() == 0);
}

// Wrapper function for sending I2C commands
/** @brief Send one startup command to the board controller. */
void sendI2CCommand(uint8_t command) {
  uint8_t error;
  // Start sending commands to the specified address
  Wire.beginTransmission(0x30);
  // Send command
  Wire.write(command);
  //  End transmission and return status
  error = Wire.endTransmission();

  if (error == 0) {
    Serial.print("command 0x");
    Serial.print(command, HEX);
    Serial.println(" Sent successfully");
  } else {
    Serial.print("Command sent error, error code:");
    Serial.println(error);
  }
}

/**
 * @brief Initialize board power, LCD, touch input, LVGL and the generated UI.
 * Called once after reset before the interactive task starts.
 */
void setup()
{
  Serial.begin(115200); 

  pinMode(19, OUTPUT);

  Wire.begin(15, 16);
  delay(50);
  while (1) {
    if (i2cScanForAddress(0x30) && i2cScanForAddress(0x5D)) {
      Serial.print("The microcontroller is detected: address 0x");
      Serial.println(0x30, HEX);
      Serial.print("The microcontroller is detected: address 0x");
      Serial.println(0x5D, HEX);
      break;
    } else {
      Serial.print("No microcontroller was detected: address 0x");
      Serial.println(0x30, HEX);
      Serial.print("No microcontroller was detected: address 0x");
      Serial.println(0x5D, HEX);
      //Prevent the microcontroller did not start to adjust the bright screen
      sendI2CCommand(250);    // 250 : Activate touch screen
      pinMode(1, OUTPUT);
      digitalWrite(1, LOW);
      //ioex.output(2, TCA9534::Level::L);
      //ioex.output(2, TCA9534::Level::H);
      delay(120);
      pinMode(1, INPUT);

      delay(100);
    }
  }
  // Start sending command 0 to address 0x30
  sendI2CCommand(0);  // 0 is the brightest backlight.    / 245 backlight off   (0-245)

  // Init Display
  gfx.init();
  gfx.initDMA();
  gfx.startWrite();
  gfx.fillScreen(TFT_BLACK);

  lv_init();
  lv_tick_set_cb(millis);
  size_t buffer_size = sizeof(lv_color_t) * LCD_H_RES * LVGL_BUFFER_LINES;
  buf = (uint8_t *)heap_caps_malloc(buffer_size, MALLOC_CAP_INTERNAL | MALLOC_CAP_8BIT);
  buf1 = (uint8_t *)heap_caps_malloc(buffer_size, MALLOC_CAP_INTERNAL | MALLOC_CAP_8BIT);
  if (buf == nullptr || buf1 == nullptr) {
    Serial.println("Failed to allocate LVGL buffers in internal RAM");
    while (true) {
      delay(1000);
    }
  }

  // Initialize display
  lv_display_t *disp = lv_display_create(LCD_H_RES, LCD_V_RES);
  lv_display_set_flush_cb(disp, my_disp_flush);
  lv_display_set_buffers(disp, buf, buf1, buffer_size, LV_DISPLAY_RENDER_MODE_PARTIAL);

  // Initialize input device driver program
  lv_indev_t *indev = lv_indev_create();
  lv_indev_set_type(indev, LV_INDEV_TYPE_POINTER);
  lv_indev_set_read_cb(indev, my_touchpad_read);

  delay(100);
  gfx.fillScreen(TFT_BLACK);
  // lv_demo_widgets();// Main UI interface
  ui_init();

  Serial.println( "Setup done" );
}

/** @brief Run LVGL timers continuously so drawing and input remain responsive. */
void loop()
{
  lv_timer_handler(); /* let the GUI do its work */
  delay(1);
}
