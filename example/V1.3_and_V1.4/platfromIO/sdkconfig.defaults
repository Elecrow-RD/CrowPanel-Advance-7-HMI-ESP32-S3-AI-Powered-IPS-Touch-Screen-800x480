## example/V1.3_and_V1.4/platfromIO/sdkconfig.defaults
```kconfig
CONFIG_LV_MEM_CUSTOM=y
CONFIG_LV_MEMCPY_MEMSET_STD=y
CONFIG_LV_ATTRIBUTE_FAST_MEM=y
CONFIG_LV_USE_USER_DATA=y
CONFIG_LV_USE_CHART=y
CONFIG_LV_USE_PERF_MONITOR=y

# 启用lvgl示例
CONFIG_LV_USE_DEMO_WIDGETS=y
# CONFIG_LV_USE_DEMO_MUSIC=y
# CONFIG_LV_USE_DEMO_STRESS=y
# CONFIG_LV_USE_DEMO_BENCHMARK=y
```

## example/V1.3_and_V1.4_and_V1.5/platfromIO/sdkconfig.defaults.esp32s3
```kconfig
# 启用 PSRAM 120M
CONFIG_SPIRAM=y
CONFIG_SPIRAM_MODE_OCT=y
CONFIG_IDF_EXPERIMENTAL_FEATURES=y
CONFIG_SPIRAM_SPEED_120M=y
CONFIG_SPIRAM_FETCH_INSTRUCTIONS=y
CONFIG_SPIRAM_RODATA=y

# 启用以下配置可以帮助在以下情况下提高 PCLK 频率：
# 帧缓冲区从 PSRAM 中分配，并由 EDMA 提取
CONFIG_FREERTOS_HZ=1000
CONFIG_ESP_DEFAULT_CPU_FREQ_MHZ_240=y
CONFIG_ESPTOOLPY_FLASHMODE_QIO=y
CONFIG_ESPTOOLPY_FLASHFREQ_120M=y
CONFIG_ESPTOOLPY_FLASHSIZE_16MB=y
CONFIG_ESP32S3_DATA_CACHE_LINE_32B=y
CONFIG_COMPILER_OPTIMIZATION_PERF=y

# 使用partitions.csv
CONFIG_PARTITION_TABLE_CUSTOM=y
CONFIG_PARTITION_TABLE_CUSTOM_FILENAME="partitions.csv"
CONFIG_PARTITION_TABLE_FILENAME="partitions.csv"

# 开启防撕裂
CONFIG_EXAMPLE_LVGL_PORT_AVOID_TEAR_ENABLE=y
```
