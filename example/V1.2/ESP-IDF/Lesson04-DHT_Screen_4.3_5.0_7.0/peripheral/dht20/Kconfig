## example/V1.2/ESP-IDF/Lesson04-DHT_Screen_4.3_5.0_7.0/peripheral/dht20/Kconfig
```kconfig
menu "DHT20 Setup"
    config DHT20_SENSOR_ENABLED
        bool "Enable DHT20 Temperature and Humidity sensor."
        depends on DEVICE_I2C_ENABLED

    if DHT20_SENSOR_ENABLED
        config I2C_ADDRESS
            hex "DHT20 I2C Address"
            default 0x38

        config FIR_FILTER_ENABLE
            bool "Enable averaging filter"
            default false
            help 
                "When enabled the averaged results of temperature and humidity are stored in the struct as well
                and accessible through dht20_data_t->temp_avg , dht20_data_t->humid_avg"
    endif
endmenu
```

## example/V1.3_and_V1.4/IDF_Code/lesson_4_DHT_screen_4.3_5.0_7.0/peripheral/i2c/Kconfig
```kconfig
menu "Device_i2c"
    config DEVICE_I2C_ENABLED
        bool "Enable I2C functions"

    if DEVICE_I2C_ENABLED
        config I2C_PORT_NUM
            int "I2C Master Port"
            default 0
        config I2C_GPIO_SCL
            int "GPIO For I2C SCL"
            default 16
        config I2C_GPIO_SDA
            int "GPIO For I2C SDA"
            default 15
        config I2C_GPIO_SCL_PULLUP
            bool "Enable SCL Pullup resistor"
            default false
        config I2C_GPIO_SDA_PULLUP
            bool "Enable SDA Pullup resistor"
            default false
        config I2C_MASTER_FREQUENCY
            int "I2C Clock frequency"
            default 400000
        config I2C_BUS_TIMEOUT
            int "Wait for response (ms)"
            default 200
    endif
endmenu
```
